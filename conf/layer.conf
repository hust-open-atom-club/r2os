## conf/machine/k230-canmv.conf
```bitbake
# SPDX-License-Identifier: MIT
#@TYPE: Machine
#@NAME: Canaan CanMV-K230
#@DESCRIPTION: Machine configuration for Canaan K230 under the local QEMU k230 machine

require conf/machine/include/riscv/tune-riscv.inc

DEFAULTTUNE = "riscv64"

SOC_FAMILY = "k230"
MACHINE_FEATURES = "serial ext2 vfat usbhost"

PREFERRED_PROVIDER_virtual/kernel ?= "linux-k230"

KERNEL_IMAGETYPE = "Image"
KERNEL_DEVICETREE = "canaan/k230-canmv.dtb"
KERNEL_DTBVENDORED = "1"

SERIAL_CONSOLES = "115200;ttyS0"

IMAGE_FSTYPES = "cpio.gz ext4 wic.gz wic.bmap tar.zst"
WKS_FILE = "k230-canmv-sdimage.wks"
WKS_FILE_DEPENDS = "mtools-native dosfstools-native e2fsprogs-native virtual/kernel"
IMAGE_BOOT_FILES = "Image k230-canmv.dtb"

EXTRA_IMAGEDEPENDS += "opensbi"
RISCV_SBI_PLAT = "generic"
RISCV_SBI_FW_TEXT_START = "0x08000000"
RISCV_SBI_PAYLOAD = "${KERNEL_IMAGETYPE}"
EXTRA_OEMAKE:append:pn-opensbi = " FW_JUMP_ADDR=0x08200000 FW_PAYLOAD_OFFSET=0x200000 FW_PAYLOAD_FDT_OFFSET="

UBOOT_ENTRYPOINT = "0x08200000"
UBOOT_LOADADDRESS = "0x08200000"

QB_MACHINE = "-machine k230-canmv"
QB_CPU = ""
QB_SMP = "-smp 1"
QB_MEM = "-m 2G"
QB_KERNEL_CMDLINE_APPEND = "console=ttyS0,115200 earlycon=sbi root=/dev/mmcblk1p2 rootwait rw"
QB_DEFAULT_FSTYPE = "wic"
QB_ROOTFS_OPT = "-drive if=sd,file=@ROOTFS@,format=raw"
QB_SERIAL_OPT = "-nographic"
QB_NETWORK_DEVICE = "-nic user,model=usb-rtl8152,hostfwd=tcp:127.0.0.1:10022-:22"
```

## meta-k230-bsp/wic/k230-canmv-sdimage.wks
```
# SPDX-License-Identifier: MIT

part /boot --source bootimg-partition --ondisk mmcblk1 --fstype=vfat --label boot --active --align 4096 --fixed-size 64
part / --source rootfs --ondisk mmcblk1 --fstype=ext4 --label root --align 4096 --fixed-size 1980

bootloader --ptable msdos --timeout=0
```

## meta-r2os-distro/conf/distro/r2os.conf
```bitbake
# SPDX-License-Identifier: MIT

require conf/distro/poky.conf

DISTRO = "r2os"
DISTRO_NAME = "R² OS"
DISTRO_VERSION = "1.0"

PACKAGE_CLASSES = "package_ipk"
EXTRA_IMAGE_FEATURES ?= "allow-empty-password empty-root-password allow-root-login"

DISTRO_FEATURES:append = " ipv4 ipv6 largefile nfs pam usrmerge overlayfs"
DISTRO_FEATURES:remove = "ptest"
BAD_RECOMMENDATIONS += "openssh-sftp-server"

VIRTUAL-RUNTIME_init_manager ?= "busybox"
VIRTUAL-RUNTIME_initscripts ?= "initscripts"
VIRTUAL-RUNTIME_login_manager ?= "busybox"
VIRTUAL-RUNTIME_syslog ?= "sysklogd"
```
